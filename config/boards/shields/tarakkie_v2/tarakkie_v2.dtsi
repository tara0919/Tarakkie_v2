/*
 * Copyright (c) 2025 The ZMK Contributors
 *
 * SPDX-License-Identifier: MIT
 */

#include <dt-bindings/zmk/matrix_transform.h>

/ {
    default_transform: keymap_transform_0 {
        compatible = "zmk,matrix-transform";
        columns = <2>;
        rows = <2>;
        map = <
        RC(0,0) // Z (Xiao)
        RC(1,0) RC(1,1) // A, B (MCP)
        >;
    };
};
