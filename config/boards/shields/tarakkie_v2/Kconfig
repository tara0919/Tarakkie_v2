## config/boards/shields/tarakkie_v2/Kconfig
```kconfig
source "Kconfig.shield"

if SHIELD_TARAKKIE_V2_LEFT || SHIELD_TARAKKIE_V2_RIGHT
    source "Kconfig.defconfig"
endif
```

## config/boards/shields/tarakkie_v2/Kconfig.defconfig
```kconfig
if SHIELD_TARAKKIE_V2_LEFT || SHIELD_TARAKKIE_V2_RIGHT

config ZMK_SPLIT
    default y

if SHIELD_TARAKKIE_V2_LEFT
config ZMK_USB
    default y

config ZMK_SPLIT_BLE_CENTRAL_BATTERY_LEVEL_FETCHING
    default y

config ZMK_SPLIT_BLE_CENTRAL_BATTERY_LEVEL_PROXY
    default y

config ZMK_SPLIT_BLE_CENTRAL_PERIPHERALS
    default 1
endif

config ZMK_BATTERY_REPORTING
    default y

endif
```

## config/boards/shields/tarakkie_v2/Kconfig.shield
```kconfig
config SHIELD_TARAKKIE_V2_LEFT
    def_bool $(shields_list_contains,tarakkie_v2_left)

config SHIELD_TARAKKIE_V2_RIGHT
    def_bool $(shields_list_contains,tarakkie_v2_right)
```
